## configs/armemulator_defconfig
```kconfig
BR2_arm=y
BR2_arm920t=y
BR2_TOOLCHAIN_BUILDROOT_GLIBC=y
BR2_KERNEL_HEADERS_CUSTOM_GIT=y
BR2_KERNEL_HEADERS_CUSTOM_REPO_URL="https://gitee.com/hxdyxd/arm-emulator-linux"
BR2_KERNEL_HEADERS_CUSTOM_REPO_VERSION="4ec8a38a506e3914237ae0b8e71ce4d59214a013"
BR2_TOOLCHAIN_BUILDROOT_CXX=y
BR2_TARGET_GENERIC_HOSTNAME="armemulator"
BR2_TARGET_GENERIC_ISSUE="Welcome to ARM Emulator"
BR2_LINUX_KERNEL=y
BR2_LINUX_KERNEL_CUSTOM_GIT=y
BR2_LINUX_KERNEL_CUSTOM_REPO_URL="https://gitee.com/hxdyxd/arm-emulator-linux"
BR2_LINUX_KERNEL_CUSTOM_REPO_VERSION="4ec8a38a506e3914237ae0b8e71ce4d59214a013"
BR2_LINUX_KERNEL_DEFCONFIG="armemulator"
BR2_LINUX_KERNEL_APPENDED_ZIMAGE=y
BR2_LINUX_KERNEL_DTB_IS_SELF_BUILT=y
BR2_LINUX_KERNEL_INTREE_DTS_NAME="arm-emulator"
BR2_PACKAGE_BUSYBOX_SHOW_OTHERS=y
BR2_PACKAGE_BINUTILS=y
BR2_PACKAGE_MAKE=y
BR2_PACKAGE_CURLFTPFS=y
BR2_PACKAGE_FBGRAB=y
BR2_PACKAGE_PERL=y
BR2_PACKAGE_LIBARCHIVE=y
BR2_PACKAGE_CA_CERTIFICATES=y
BR2_PACKAGE_FREETYPE=y
BR2_PACKAGE_JPEG=y
BR2_PACKAGE_LIBCURL_CURL=y
BR2_PACKAGE_NCURSES=y
BR2_PACKAGE_DROPBEAR=y
BR2_PACKAGE_NET_TOOLS=y
BR2_PACKAGE_NTP=y
BR2_PACKAGE_NTP_NTPDATE=y
BR2_PACKAGE_WGET=y
BR2_PACKAGE_ARMEMULATOR=y
BR2_TARGET_ROOTFS_EXT2=y
BR2_TARGET_ROOTFS_EXT2_SIZE="512M"
# BR2_TARGET_ROOTFS_TAR is not set
BR2_PACKAGE_HOST_MKPASSWD=y
```

## package/armemulator/Config.in
```kconfig
config BR2_PACKAGE_ARMEMULATOR
        bool "armemulator"
		depends on BR2_TOOLCHAIN_HAS_THREADS
		depends on BR2_USE_WCHAR # gettext
		select BR2_PACKAGE_LIBGLIB2
        help
          arm emulator tool support

          https://github.com/hxdyxd/arm_emulator
```

## package/ethoslip_tun/Config.in
```kconfig
config BR2_PACKAGE_ETHOSLIP_TUN
        bool "ethoslip_tun"
        help
          ethoslip_tun tool support

          https://github.com/hxdyxd/ethoslip_tun
```
